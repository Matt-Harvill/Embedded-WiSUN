/**
 * @cliArgs --board "/ti/boards/LP_CC1352P7_1" --rtos "tirtos" --product "simplelink_cc13xx_cc26xx_sdk@5.40.00.40"
 * @versions {"tool":"1.10.0+2163"}
 */

/**
 * Import the modules used in this configuration.
 */
const CCFG        = scripting.addModule("/ti/devices/CCFG");
const ADCBuf      = scripting.addModule("/ti/drivers/ADCBuf", {}, false);
const ADCBuf1     = ADCBuf.addInstance();
const GPIO        = scripting.addModule("/ti/drivers/GPIO", {}, false);
const GPIO11      = GPIO.addInstance();
const NVS         = scripting.addModule("/ti/drivers/NVS");
const NVS1        = NVS.addInstance();
const RF          = scripting.addModule("/ti/drivers/RF");
const RTOS        = scripting.addModule("/ti/drivers/RTOS");
const TRNG        = scripting.addModule("/ti/drivers/TRNG", {}, false);
const TRNG1       = TRNG.addInstance();
const TRNG2       = TRNG.addInstance();
const UART        = scripting.addModule("/ti/drivers/UART", {}, false);
const UART1       = UART.addInstance();
const Watchdog    = scripting.addModule("/ti/drivers/Watchdog", {}, false);
const Watchdog1   = Watchdog.addInstance();
const Button      = scripting.addModule("/ti/drivers/apps/Button");
const Button1     = Button.addInstance();
const Button2     = Button.addInstance();
const LED         = scripting.addModule("/ti/drivers/apps/LED");
const LED1        = LED.addInstance();
const LED2        = LED.addInstance();
const ti_wisunfan = scripting.addModule("/ti/ti_wisunfan/ti_wisunfan");

/**
 * Write custom configuration values to the imported modules.
 */
CCFG.xoscCapArray             = true;
CCFG.xoscCapArrayDelta        = 0xC1;
CCFG.enableBootloader         = true;
CCFG.enableBootloaderBackdoor = true;
CCFG.dioBootloaderBackdoor    = 15;
CCFG.levelBootloaderBackdoor  = "Active low";
CCFG.ccfgTemplate.$name       = "ti_devices_CCFGTemplate0";

ADCBuf1.$name                             = "CONFIG_ADCBUF_0";
ADCBuf1.timerInstance.$name               = "CONFIG_GPTIMER_0";
ADCBuf1.adcBufChannel0.$name              = "ADCBUF_CHANNEL_0";
ADCBuf1.adcBufChannel0.adc.$assign        = "ADC0";
ADCBuf1.adcBufChannel0.adc.adcPin.$assign = "boosterpack.25";

GPIO11.$name           = "CONFIG_GPIO_PIR";
GPIO11.gpioPin.$assign = "boosterpack.24";

NVS1.$name                    = "CONFIG_NVSINTERNAL";
NVS1.internalFlash.$name      = "ti_drivers_nvs_NVSCC26XX0";
NVS1.internalFlash.regionBase = 0x52000;
NVS1.internalFlash.regionSize = 0x4000;

RF.$hardware = system.deviceData.board.components["SKY13317-373LF"];

TRNG1.$name = "NANOSTACK_TRNG";

TRNG2.$name = "CONFIG_TRNG_0";

UART1.$name               = "CONFIG_UART_0";
UART1.$hardware           = system.deviceData.board.components.XDS110UART;
UART1.txPinInstance.$name = "CONFIG_GPIO_0";
UART1.rxPinInstance.$name = "CONFIG_GPIO_1";

Watchdog1.$name = "CONFIG_WATCHDOG_0";

Button1.$hardware     = system.deviceData.board.components["BTN-1"];
Button1.$name         = "CONFIG_BTN_LEFT";
Button1.gpioPin.$name = "CONFIG_GPIO_BTN1";
Button1.gpioPin.pull  = "Pull Up";

Button2.$hardware     = system.deviceData.board.components["BTN-2"];
Button2.$name         = "CONFIG_BTN_RIGHT";
Button2.gpioPin.$name = "CONFIG_GPIO_BTN2";
Button2.gpioPin.pull  = "Pull Up";

LED1.$hardware     = system.deviceData.board.components.LED_RED;
LED1.$name         = "CONFIG_LED_RED";
LED1.gpioPin.$name = "CONFIG_GPIO_RLED";

LED2.$hardware     = system.deviceData.board.components.LED_GREEN;
LED2.$name         = "CONFIG_LED_GREEN";
LED2.gpioPin.$name = "CONFIG_GPIO_GLED";

ti_wisunfan.project                            = "routernode";
ti_wisunfan.lockProject                        = true;
ti_wisunfan.rxOnIdle                           = true;
ti_wisunfan.panID                              = 0xABCD;
ti_wisunfan.radioConfig.$name                  = "ti_devices_radioconfig_settings_prop0";
ti_wisunfan.radioConfig.codeExportConfig.$name = "ti_devices_radioconfig_code_export_param0";
ti_wisunfan.aesccmModule.$name                 = "CONFIG_AESCCM_0";
ti_wisunfan.aesecbModule.$name                 = "CONFIG_AESECB_0";
ti_wisunfan.aescbcModule.$name                 = "CONFIG_AESCBC_0";

/**
 * Pinmux solution for unlocked pins/peripherals. This ensures that minor changes to the automatic solver in a future
 * version of the tool will not impact the pinmux you originally saw.  These lines can be completely deleted in order to
 * re-solve from scratch.
 */
ADCBuf1.adc.$suggestSolution                 = "ADC0";
ADCBuf1.adc.dmaADCChannel.$suggestSolution   = "DMA_CH7";
ADCBuf1.timerInstance.timer.$suggestSolution = "GPTM0";
RF.rfAntennaPin0.$suggestSolution            = "ball.41";
RF.rfAntennaPin1.$suggestSolution            = "ball.42";
RF.rfAntennaPin2.$suggestSolution            = "ball.43";
UART1.uart.$suggestSolution                  = "UART0";
UART1.uart.txPin.$suggestSolution            = "boosterpack.4";
UART1.uart.rxPin.$suggestSolution            = "boosterpack.3";
Watchdog1.watchdog.$suggestSolution          = "WDT0";
Button1.button.$suggestSolution              = "boosterpack.13";
Button2.button.$suggestSolution              = "boosterpack.8";
LED1.ledPin.$suggestSolution                 = "boosterpack.39";
LED2.ledPin.$suggestSolution                 = "boosterpack.40";
